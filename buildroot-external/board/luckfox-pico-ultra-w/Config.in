## buildroot-external/board/luckfox-pico-ultra-w/Config.in
```kconfig
config BR2_TARGET_LUCKFOX_PICO_ULTRA_W
	bool "Luckfox Pico Ultra W"
	depends on BR2_arm
	depends on BR2_ARM_CPU_ARMV7A
	select BR2_PACKAGE_LUCKFOX_PICO_DRIVERS
	help
	  Buildroot configuration for Luckfox Pico Ultra W
	  - RV1106 ARM Cortex-A7 SoC
	  - 2GB RAM
	  - eMMC storage
	  - WiFi + Bluetooth
	  - Camera support
	  - NPU for AI workloads
```

## buildroot-external/board/luckfox-pico/Config.in
```kconfig
config BR2_TARGET_LUCKFOX_PICO
	bool "Luckfox Pico"
	select BR2_arm
	select BR2_ARM_CPU_ARMV7A
	select BR2_ARM_FPU_VFPV4
	select BR2_ARM_EABIHF
	select BR2_ARM_INSTRUCTIONS_ARM
	help
	  Luckfox Pico development board with RaspberryMatic support.
	  
	  This board provides:
	  - RV1103/RV1106 ARM Cortex-A7 SoC
	  - Camera/ISP support for smart home monitoring
	  - NPU for AI-powered home automation
	  - WiFi and Ethernet connectivity
	  - Full HomeMatic/homematicIP compatibility
	  
	  https://github.com/LuckfoxTECH/luckfox-pico
```

## buildroot-external/package/luckfox-firmware/Config.in
```kconfig
config BR2_PACKAGE_LUCKFOX_FIRMWARE
	bool "Luckfox Firmware Package"
	help
	  Downloads and installs firmware files from Luckfox repository
	  during the build process.
	  
	  This package provides:
	  - WiFi firmware for AIC8800DC
	  - MCU firmware for RV1106
	  - U-Boot binaries and configuration
	  - Kernel modules and drivers
	  
	  The firmware is automatically downloaded from the official
	  Luckfox repository during build, ensuring the latest versions
	  are always used.
```

## buildroot-external/package/luckfox-pico-drivers/Config.in
```kconfig
config BR2_PACKAGE_LUCKFOX_PICO_DRIVERS
	bool "luckfox-pico-drivers"
	depends on BR2_LINUX_KERNEL
	help
	  Custom drivers and hardware support for Luckfox Pico boards
	  in RaspberryMatic, based on the official LuckfoxTECH SDK.
	  
	  This package provides:
	  - Camera/ISP drivers from LuckfoxTECH SDK (sysdrv/)
	  - Media libraries for video processing (media/)
	  - NPU drivers for AI workloads (RV1106)
	  - Custom GPIO, I2C, SPI configurations
	  - Board-specific hardware support
	  - HomeMatic integration scripts
	  
	  The drivers are extracted from the official SDK at:
	  https://github.com/LuckfoxTECH/luckfox-pico
	  
	  Note: This requires the LuckfoxTECH SDK to be available
	  during the build process.
```
